## board/Kconfig
```kconfig
menu "Hardware Drivers Config"

    menu "On-chip Peripheral Drivers"
        source "./libraries/ma35/rtt_port/Kconfig_ma35h0"
    endmenu

    menu "On-board Peripheral Drivers"

        config BSP_USING_CONSOLE
            bool "Enable UART0 for RTT Console(uart0)"
            select BSP_USING_UART
            select BSP_USING_UART0
            default y

        config BOARD_USING_NAU8822
            bool "NAU8822 Audio Codec supporting(over i2s0, i2c0)"
            select NU_PKG_USING_NAU8822
            select BSP_USING_I2C0
            select BSP_USING_I2S
            select BSP_USING_I2S0
            default n

        config BOARD_USING_STORAGE_SDCARD
            bool "SDCARD supporting"
            select BSP_USING_SDH
            select BSP_USING_SDH0
            select BSP_USING_SDH1
            default y


        config BOARD_USING_STORAGE_RAWNAND
            bool "Raw NAND supporting(over nfi)"
            select BSP_USING_NFI
            select RT_USING_MTD_NAND
            default y

        config BOARD_USING_QSPI_FLASH
            bool "SPI NOR FLASH supporting(over qspi0)"
            select BSP_USING_QSPI
            select BSP_USING_QSPI0
            default n

        config BOARD_USING_STORAGE_SPINAND
            bool "SPI NAND FLASH supporting(over qspi0)"
            select BSP_USING_QSPI
            select BSP_USING_QSPI0
            select NU_PKG_USING_SPINAND
            default y

        config BOARD_USING_USBHOST
            bool "USB HOST function"
            select BSP_USING_USBH
            default y

    endmenu

    menu "Board extended module drivers"

        config BOARD_USING_LCM
            bool "Use LCD panel."
            default y

        if BOARD_USING_LCM

            choice
                prompt "Select LCD panel devices.(Over DISP)"
                    default BOARD_USING_LCM_FW070TFT_WSVGA

                config BOARD_USING_LCM_FW070TFT_WSVGA
                    bool "NuDesign TFT-LCD7-WSVGA"
                    select BSP_USING_DISP
                    select LCD_USING_FW070TFT_WSVGA
                    help
                        Choose this option if you use 7" 1024x600x32b LCD panel.

                config BOARD_USING_LCM_FW070TFT_WVGA
                    bool "NuDesign TFT-LCD7-WVGA"
                    select BSP_USING_DISP
                    select LCD_USING_FW070TFT
                    help
                        Choose this option if you use 7" 800x480x32b LCD panel.

                config BOARD_USING_LCM_RGB_CONVERTER
                    bool "RGB Converter"
                    select BSP_USING_DISP
                    select LCD_USING_CUSTOMER
                    help
                        Choose this option if you use RGB Converter in LCD board.

            endchoice

            config BOARD_USING_VDDIO4_1_8V
                bool "Set VDDIO4 to 1.8V"
                default n

            config BOARD_USING_LCM_TOUCH
                bool "Use LCD touch panel."
                default y

            if BOARD_USING_LCM_TOUCH
                choice
                    prompt "Select Touch devices."
                        default BOARD_USING_GT911

                    config BOARD_USING_GT911
                        bool "GT911 TPC"
                        select BSP_USING_I2C
                        select BSP_USING_I2C5
                        select NU_PKG_USING_TPC_GT911
                        help
                            Choose this option if you use GT911 external TSC touching function.

                    config BOARD_USING_ILI2511
                        bool "ILI2511 TPC"
                        select BSP_USING_I2C
                        select BSP_USING_I2C5
                        select NU_PKG_USING_TPC_ILI
                        help
                            Choose this option if you use ILI external TSC touching function.

                    config BOARD_USING_ADCTOUCH
                        bool "ADC touching"
                        select BSP_USING_ADC_TOUCH
                        select NU_PKG_USING_ADC_TOUCH
                        help
                            Choose this option if you use internal ADC touching function.

                endchoice
            endif
        endif

    endmenu

    source "./libraries/nu_packages/Kconfig"

endmenu
```
